## firmware/kc2_zmk/boards/shields/kc2/Kconfig.defconfig
```kconfig
if SHIELD_KC2_LEFT

config ZMK_KEYBOARD_NAME
    default "KC2"

config ZMK_SPLIT_ROLE_CENTRAL
    default y

endif

if SHIELD_KC2_LEFT || SHIELD_KC2_RIGHT

config ZMK_SPLIT
    default y

config ZMK_PM_SOFT_OFF
    default y

endif
```

## firmware/kc2_zmk/boards/shields/kc2/Kconfig.shield
```kconfig
config SHIELD_KC2_LEFT
    def_bool $(shields_list_contains,kc2_left)

config SHIELD_KC2_RIGHT
    def_bool $(shields_list_contains,kc2_right)
```

## firmware/kc2_zmk/boards/shields/kc2_x3_v2/Kconfig.defconfig
```kconfig
if SHIELD_KC2_X3_V2_LEFT

config ZMK_KEYBOARD_NAME
    default "KC2 X3 V2"

config ZMK_SPLIT_ROLE_CENTRAL
    default y

endif

if SHIELD_KC2_X3_V2_LEFT || SHIELD_KC2_X3_V2_RIGHT

config ZMK_SPLIT
    default y

endif
```

## firmware/kc2_zmk/boards/shields/kc2_x3_v2/Kconfig.shield
```kconfig
config SHIELD_KC2_X3_V2_LEFT
    def_bool $(shields_list_contains,kc2_x3_v2_left)

config SHIELD_KC2_X3_V2_RIGHT
    def_bool $(shields_list_contains,kc2_x3_v2_right)
```

## firmware/kc2_zmk/dts/bindings/behaviors/kc2,behavior-power-off.yaml
```yaml
# Copyright (c) 2026 The KC2 Contributors
# SPDX-License-Identifier: MIT

description: KC2 blue-LED-confirmed software power-off behavior

compatible: "kc2,behavior-power-off"

include: zero_param.yaml
```
