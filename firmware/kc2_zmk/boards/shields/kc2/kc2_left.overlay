#include "kc2.dtsi"

/ {
    kscan0: kscan {
        compatible = "zmk,kscan-gpio-matrix";
        wakeup-source;
        diode-direction = "col2row";

        col-gpios = <&gpio0 20 GPIO_ACTIVE_HIGH>, <&gpio0 24 GPIO_ACTIVE_HIGH>, <&gpio0 22 GPIO_ACTIVE_HIGH>, <&gpio1 0 GPIO_ACTIVE_HIGH>, <&gpio0 11 GPIO_ACTIVE_HIGH>, <&gpio1 4 GPIO_ACTIVE_HIGH>, <&gpio1 6 GPIO_ACTIVE_HIGH>;
        row-gpios = <&gpio0 9 (GPIO_ACTIVE_HIGH | GPIO_PULL_DOWN)>, <&gpio0 10 (GPIO_ACTIVE_HIGH | GPIO_PULL_DOWN)>, <&gpio1 11 (GPIO_ACTIVE_HIGH | GPIO_PULL_DOWN)>, <&gpio1 13 (GPIO_ACTIVE_HIGH | GPIO_PULL_DOWN)>, <&gpio1 15 (GPIO_ACTIVE_HIGH | GPIO_PULL_DOWN)>;
    };

    soft_off_wakers: soft_off_wakers {
        compatible = "zmk,soft-off-wakeup-sources";
        wakeup-sources = <&kscan0>;
    };
};
