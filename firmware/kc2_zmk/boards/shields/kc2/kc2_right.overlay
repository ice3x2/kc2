#include "kc2.dtsi"

&default_transform {
    col-offset = <7>;
};

/ {
    kscan0: kscan {
        compatible = "zmk,kscan-gpio-matrix";
        wakeup-source;
        diode-direction = "col2row";

        col-gpios = <&gpio1 6 GPIO_ACTIVE_HIGH>, <&gpio0 9 GPIO_ACTIVE_HIGH>, <&gpio0 10 GPIO_ACTIVE_HIGH>, <&gpio1 11 GPIO_ACTIVE_HIGH>, <&gpio1 13 GPIO_ACTIVE_HIGH>, <&gpio1 15 GPIO_ACTIVE_HIGH>, <&gpio0 2 GPIO_ACTIVE_HIGH>, <&gpio0 31 GPIO_ACTIVE_HIGH>, <&gpio0 29 GPIO_ACTIVE_HIGH>;
        row-gpios = <&gpio0 20 (GPIO_ACTIVE_HIGH | GPIO_PULL_DOWN)>, <&gpio0 22 (GPIO_ACTIVE_HIGH | GPIO_PULL_DOWN)>, <&gpio0 24 (GPIO_ACTIVE_HIGH | GPIO_PULL_DOWN)>, <&gpio0 17 (GPIO_ACTIVE_HIGH | GPIO_PULL_DOWN)>, <&gpio0 11 (GPIO_ACTIVE_HIGH | GPIO_PULL_DOWN)>;
    };
};
